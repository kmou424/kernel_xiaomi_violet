/*
 * Copyright (C) 2020 The LineageOS Project
 *
 * this file is for attribution only of violet
 * And public attribution of Xiaomi platforms (like F7B and so)
 */

&mtp_batterydata {
    #include "battery/LC_M6300_ATL4000mAh_3633204_FG.dtsi"
    #include "battery/LC_M6300_Sunwoda4000mAh_3632066_FG.dtsi"
    #include "battery/LC_M6300_Coslight_4000mAh_3884533_FG.dtsi"
};

&pm6150_qg {
	qcom,battery-data = <&mtp_batterydata>;
	qcom,vbatt-cutoff-mv = <3400>;
	qcom,vbatt-low-mv = <3500>;
	qcom,vbatt-low-cold-mv = <3700>;
	qcom,vbatt-empty-mv = <3100>;
	qcom,vbatt-empty-cold-mv = <3100>;
	qcom,s3-entry-fifo-length = <2>;
	qcom,s3-entry-ibat-ua = <18000>;
	qcom,s3-exit-ibat-ua = <38000>;
	qcom,qg-iterm-ma = <350>;
	qcom,hold-soc-while-full;
	qcom,linearize-soc;
	qcom,cl-feedback-on;
	qcom,shutdown-delay-enable;
	qcom,cold-thermal-support;
	mi,cold_thermal_seq = <0x01 0x00 0x96 0x4b0 0x02 0xfffffe70 0x00 0x258>;
};

&pm6150_charger {
	io-channels = <&pm6150_vadc ADC_USB_IN_V_16>,
		      <&pm6150_vadc ADC_USB_IN_I>,
		      <&pm6150_vadc ADC_CHG_TEMP>,
		      <&pm6150_vadc ADC_DIE_TEMP>,
		      <&pm6150_vadc ADC_AMUX_THM4_PU2>,
		      <&pm6150_vadc ADC_SBUx>,
		      <&pm6150_vadc ADC_VPH_PWR>;
	io-channel-names = "usb_in_voltage",
			   "usb_in_current",
			   "chg_temp",
			   "die_temp",
			   "conn_temp",
			   "sbux_res",
			   "vph_voltage";
	qcom,battery-data = <&mtp_batterydata>;
	qcom,auto-recharge-soc = <99>;
	qcom,step-charging-enable;
	qcom,sw-jeita-enable;
	qcom,fcc-stepping-enable;
	qcom,suspend-input-on-debug-batt;
	qcom,sec-charger-config = <0>;
	qcom,qg-vadc = <&pm6150_vadc>;
	qcom,thermal-mitigation = <3000000
            2500000 2300000 2000000 1500000 800000 500000 100000 50000 0>;
	dpdm-supply = <&qusb_phy0>;
	qcom,charger-temp-max = <800>;
	qcom,smb-temp-max = <800>;
	qcom,chg-term-src = <1>;
	qcom,chg-term-current-ma = <(-200)>;
};

&pm6150_pdphy{
    qcom,default-sink-caps = <5000 3000>,
                         <9000 3000>;
};
